## sdkconfig.defaults.esp32p4
```kconfig
CONFIG_IDF_TARGET="esp32p4"
CONFIG_ESPTOOLPY_FLASHSIZE_16MB=y
CONFIG_ESPTOOLPY_FLASHMODE_QIO=y

CONFIG_SPIRAM=y
CONFIG_SPIRAM_SPEED_200M=y
CONFIG_SPIRAM_XIP_FROM_PSRAM=y
CONFIG_ESP_MAIN_TASK_STACK_SIZE=10240
CONFIG_FREERTOS_HZ=1000
CONFIG_FREERTOS_VTASKLIST_INCLUDE_COREID=y
CONFIG_FREERTOS_GENERATE_RUN_TIME_STATS=y

CONFIG_SPIRAM_MALLOC_ALWAYSINTERNAL=4096
CONFIG_SPIRAM_MALLOC_RESERVE_INTERNAL=65536
CONFIG_SPIRAM_TRY_ALLOCATE_WIFI_LWIP=y
CONFIG_SPIRAM_MEMTEST=n
CONFIG_ESP_SYSTEM_ALLOW_RTC_FAST_MEM_AS_HEAP=n
CONFIG_MBEDTLS_EXTERNAL_MEM_ALLOC=y

CONFIG_SLAVE_IDF_TARGET_ESP32C6=y
CONFIG_ESP_HOSTED_P4_DEV_BOARD_FUNC_BOARD=y
CONFIG_ESP_HOSTED_SDIO_HOST_INTERFACE=y
CONFIG_ESP_HOSTED_SDIO_4_BIT_BUS=y

CONFIG_SR_WN_WN9_NIHAOXIAOZHI_TTS=y

CONFIG_IDF_EXPERIMENTAL_FEATURES=y

# ESP32-P4 芯片版本(使用 v3+ 以支持 PIE 向量指令,esp-dl 需要)
# CONFIG_ESP32P4_SELECTS_REV_LESS_V3=y

CONFIG_COMPILER_OPTIMIZATION_PERF=y

# 禁用 OTA(单 App 分区,无 ota_0/ota_1)
CONFIG_BOOTLOADER_APP_ROLLBACK_ENABLE=n
CONFIG_APP_ROLLBACK_ENABLE=n

# 禁用 GCC 14.2 的 stringop-overflow 警告(esp-dl 库的误报)
CONFIG_COMPILER_WARN_WRITE_STRINGS=n
CONFIG_COMPILER_STACK_CHECK_MODE_NONE=y

CONFIG_ESP_VIDEO_ENABLE_ISP_PIPELINE_CONTROLLER=y
CONFIG_CAMERA_SC2336=y
CONFIG_USB_HOST_CONTROL_TRANSFER_MAX_SIZE=1024

# LVGL Graphics
CONFIG_LV_USE_SNAPSHOT=y

# 人脸识别(esp-dl)
# 模型存储在 FLASH_RODATA(嵌入固件)
CONFIG_HUMAN_FACE_DETECT_MODEL_IN_FLASH_RODATA=y
CONFIG_HUMAN_FACE_FEAT_MODEL_IN_FLASH_RODATA=y
# 启用 MSRMNP_S8_V1 检测模型和 MFN_S8_V1 特征模型
CONFIG_FLASH_HUMAN_FACE_DETECT_MSRMNP_S8_V1=y
CONFIG_FLASH_HUMAN_FACE_FEAT_MFN_S8_V1=y
CONFIG_HUMAN_FACE_DETECT_MSRMNP_S8_V1=y
CONFIG_HUMAN_FACE_FEAT_MFN_S8_V1=y

# FAT 文件系统(用于人脸数据库存储)
CONFIG_FATFS_LFN_HEAP=y
CONFIG_FATFS_LFN_UNICODE=y

# 禁用 esp-dl 的 PIE 向量汇编优化(ESP-IDF 5.5.3 汇编器不兼容)
# 使用 C++ 实现的颜色转换替代
CONFIG_PIX_CVT_RGB565_TO_RGB565_SUPPORT=n
CONFIG_PIX_CVT_RGB565_TO_RGB888_SUPPORT=n
CONFIG_PIX_CVT_RGB565_TO_GRAY_SUPPORT=n
CONFIG_PIX_CVT_RGB565_TO_HSV_SUPPORT=n
CONFIG_PIX_CVT_RGB888_TO_RGB888_SUPPORT=y
CONFIG_PIX_CVT_RGB888_TO_RGB565_SUPPORT=n
CONFIG_PIX_CVT_RGB888_TO_GRAY_SUPPORT=n
CONFIG_PIX_CVT_RGB888_TO_HSV_SUPPORT=n
CONFIG_PIX_CVT_GRAY_TO_GRAY_SUPPORT=n
CONFIG_PIX_CVT_HSV_TO_HSV_MASK_SUPPORT=n
CONFIG_PIX_CVT_YUV_TO_RGB888_SUPPORT=n
CONFIG_PIX_CVT_YUV_TO_RGB565_SUPPORT=n
CONFIG_PIX_CVT_YUV_TO_GRAY_SUPPORT=n
CONFIG_PIX_CVT_YUV_TO_HSV_SUPPORT=n
CONFIG_PIX_CVT_YUV_TO_YUV_SUPPORT=n
```
